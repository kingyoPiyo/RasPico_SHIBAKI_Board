#include "hardware/pio.h"
#include "rx_func.h"
#include "rx.pio.h"
#include "hw.h"

// 8b10b K28.5 Code
#define DEF_K28_5_RDN           (0b0011111010)  // 0x0FA (250)
#define DEF_K28_5_RDP           (0b1100000101)  // 0x305 (773)

// 10b -> 8b decode
// 0x0xx is valid data
// 0x100 is Undefined
// 0x200 is K28.5
static const uint16_t __not_in_flash("dec_tbl") dec_tbl[1024] = {
    0x100, 0x100, 0x100, 0x100, 0x100, 0x100, 0x100, 0x100, 0x100, 0x100, 0x100, 0x100, 0x100, 0x100, 0x100, 0x100, // 15
    0x100, 0x100, 0x100, 0x100, 0x100, 0x100, 0x100, 0x100, 0x100, 0x100, 0x100, 0x100, 0x100, 0x100, 0x100, 0x100, // 31
    0x100, 0x100, 0x100, 0x100, 0x100, 0x100, 0x100, 0x100, 0x100, 0x100, 0x100, 0x100, 0x100, 0x100, 0x100, 0x100, // 47
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    0x100, 0x100, 0x100, 0x100, 0x100, 0x100, 0x100, 0x100, 0x100, 0x100, 0x100, 0x100, 0x100, 0x100, 0x100, 0x100, // 1023
};

// ----------------------------------------
// 8b10b Decoder
//  - in_data   : 10bit data input
//  - out_data  : 8bit data output
// return
//  - 0 : valid data
//  - 1 : Undefined
//  - 2 : K28.5
// ----------------------------------------
static inline __attribute__((always_inline)) uint8_t tbl_8b10b_dec (uint32_t in_data, uint8_t* out_data)
{
    uint16_t tmp = dec_tbl[in_data];

    *out_data = tmp & 0x00FF;
    return (tmp >> 8);
}

//void __not_in_flash_func(rx_main)(void)
void __time_critical_func(rx_main)(void)
{
    // RX init
    PIO pio = pio1;
    uint sm = 0;
    uint offset = pio_add_program(pio, &rx10b_program);
    rx10b_program_init(pio, sm, offset, HW_PINNUM_SFP1_RXD);

    uint32_t read10b = 0;
    uint32_t shift_reg = 0;
    uint32_t data_10b = 0;
    uint32_t shift_num = 0;
    uint8_t data_8b = 0;
    uint8_t rx_cnt = 0;
    bool locked = false;

    while (true){}

    while (true)
    {
        // Read RX FIFO
        read10b = rx10b_program_get10b(pio, sm);    // [31:10]:zero, [9:0]:data

        shift_reg = (shift_reg << 10) + (read10b & 0x3FF);
        data_10b = (shift_reg >> shift_num) & 0x3FF;

        switch (tbl_8b10b_dec(data_10b, &data_8b))
        {
            // Valid data
            case 0:
                // Raw PLS OUTPUT
                gpio_put(HW_PINNUM_LED3, (data_8b & 0x01) && locked);

                if (!locked && rx_cnt == 0)
                {
                    if (++shift_num >= 10) shift_num = 0;
                }

                break;
            
            // Undefined
            case 1:
                locked = false;
                if (rx_cnt == 0)
                {
                    if (++shift_num >= 10) shift_num = 0;
                }
                break;

            // K28.5
            case 2:
                locked = true;
                break;
            
            default:
                break;
        }

        rx_cnt++;
    }
}
